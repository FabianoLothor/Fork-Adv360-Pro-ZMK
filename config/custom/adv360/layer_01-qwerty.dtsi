L01_QWERTY {
    bindings = <
    // ╭────────────────────────┬────────────────────────┬────────────────────────┬────────────────────────┬────────────────────────┬────────────────────────┬────────────────────────┬────────────────────────┬────────────────────────┬────────────────────────┬────────────────────────┬────────────────────────┬────────────────────────┬────────────────────────┬────────────────────────┬────────────────────────┬────────────────────────┬────────────────────────╮
         &trans                   &kp N1                   &kp N2                   &kp N3                   &kp N4                   &kp N5                   &B_HT_MO_L L08 C_VOL_DN                                                                                                      &B_HT_MO_L L08 C_VOL_UP  &kp N6                   &kp N7                   &kp N8                   &kp N9                   &kp N0                   &trans
    // ├────────────────────────┼────────────────────────┼────────────────────────┼────────────────────────┼────────────────────────┼────────────────────────┼────────────────────────┼────────────────────────┼────────────────────────┼────────────────────────┼────────────────────────┼────────────────────────┼────────────────────────┼────────────────────────┼────────────────────────┼────────────────────────┼────────────────────────┼────────────────────────┤
         &trans                   &kp Q                    &kp W                    &kp E                    &kp R                    &kp T                    &B_HT_MO_L L07 LC(X)                                                                                                         &B_HT_MO_L L07 RC(V)     &kp Y                    &kp U                    &kp I                    &kp O                    &kp P                    &trans
    // ├────────────────────────┼────────────────────────┼────────────────────────┼────────────────────────┼────────────────────────┼────────────────────────┼────────────────────────┼────────────────────────┼────────────────────────┼────────────────────────┼────────────────────────┼────────────────────────┼────────────────────────┼────────────────────────┼────────────────────────┼────────────────────────┼────────────────────────┼────────────────────────┤
         &trans                   &kp A                    &kp S                    &kp D                    &kp F                    &kp G                    &B_HT_MO_L L06 LC(C)     &trans                   &trans                   &trans                   &trans                   &B_HT_MO_L L06 RS(RC(V)) &kp H                    &kp J                    &kp K                    &kp L                    &kp SEMI                 &kp EQUAL
    // ├────────────────────────┼────────────────────────┼────────────────────────┼────────────────────────┼────────────────────────┼────────────────────────┼────────────────────────┼────────────────────────┼────────────────────────┼────────────────────────┼────────────────────────┼────────────────────────┼────────────────────────┼────────────────────────┼────────────────────────┼────────────────────────┼────────────────────────┼────────────────────────┤
         &trans                   &kp Z                    &kp X                    &kp C                    &kp V                    &kp B                                                                      &trans                   &trans                                                                     &kp N                    &kp M                    &kp COMMA                &kp DOT                  &kp FSLH                 &trans
    // ├────────────────────────┼────────────────────────┼────────────────────────┼────────────────────────┼────────────────────────┼────────────────────────┼────────────────────────┼────────────────────────┼────────────────────────┼────────────────────────┼────────────────────────┼────────────────────────┼────────────────────────┼────────────────────────┼────────────────────────┼────────────────────────┼────────────────────────┼────────────────────────┤
         &mo L00                  &kp GRAVE                &kp MINUS                &kp LC(Z)                &kp LC(LEFT)                                      &trans                   &trans                   &trans                   &trans                   &trans                   &trans                                            &kp RC(RIGHT)            &kp RC(Y)                &kp SQT                  &kp BSLH                 &mo L00
    // ╰────────────────────────┼────────────────────────┼────────────────────────┼────────────────────────┼────────────────────────┼────────────────────────┼────────────────────────┼────────────────────────┼────────────────────────┼────────────────────────┼────────────────────────┼────────────────────────┼────────────────────────┼────────────────────────┼────────────────────────┼────────────────────────┼────────────────────────┼────────────────────────╯
    >;
};
