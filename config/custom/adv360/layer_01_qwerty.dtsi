L01_QWERTY {
    bindings = <
    // ╭────────────────────────┬────────────────────────┬────────────────────────┬────────────────────────┬────────────────────────┬────────────────────────┬────────────────────────┬────────────────────────┬────────────────────────┬────────────────────────┬────────────────────────┬────────────────────────┬────────────────────────┬────────────────────────┬────────────────────────┬────────────────────────┬────────────────────────┬────────────────────────╮
         &trans                   &kp N1                   &kp N2                   &kp N3                   &kp N4                   &kp N5                   &none                                                                                                                        &none                    &kp N6                   &kp N7                   &kp N8                   &kp N9                   &kp N0                   &trans
    // ├────────────────────────┼────────────────────────┼────────────────────────┼────────────────────────┼────────────────────────┼────────────────────────┼────────────────────────┼────────────────────────┼────────────────────────┼────────────────────────┼────────────────────────┼────────────────────────┼────────────────────────┼────────────────────────┼────────────────────────┼────────────────────────┼────────────────────────┼────────────────────────┤
         &trans                   &kp Q                    &kp W                    &kp E                    &kp R                    &kp T                    &none                                                                                                                        &none                    &kp Y                    &kp U                    &kp I                    &kp O                    &kp P                    &trans
    // ├────────────────────────┼────────────────────────┼────────────────────────┼────────────────────────┼────────────────────────┼────────────────────────┼────────────────────────┼────────────────────────┼────────────────────────┼────────────────────────┼────────────────────────┼────────────────────────┼────────────────────────┼────────────────────────┼────────────────────────┼────────────────────────┼────────────────────────┼────────────────────────┤
         &trans                   &kp A                    &kp S                    &kp D                    &kp F                    &kp G                    &none                    &trans                   &trans                   &trans                   &trans                   &none                    &kp H                    &kp J                    &kp K                    &kp L                    &kp SEMI                 &kp EQUAL
    // ├────────────────────────┼────────────────────────┼────────────────────────┼────────────────────────┼────────────────────────┼────────────────────────┼────────────────────────┼────────────────────────┼────────────────────────┼────────────────────────┼────────────────────────┼────────────────────────┼────────────────────────┼────────────────────────┼────────────────────────┼────────────────────────┼────────────────────────┼────────────────────────┤
         &trans                   &kp Z                    &kp X                    &kp C                    &kp V                    &kp B                                                                      &trans                   &trans                                                                     &kp N                    &kp M                    &kp COMMA                &kp DOT                  &kp FSLH                 &trans
    // ├────────────────────────┼────────────────────────┼────────────────────────┼────────────────────────┼────────────────────────┼────────────────────────┼────────────────────────┼────────────────────────┼────────────────────────┼────────────────────────┼────────────────────────┼────────────────────────┼────────────────────────┼────────────────────────┼────────────────────────┼────────────────────────┼────────────────────────┼────────────────────────┤
         &trans                   &kp BSLH                 &kp GRAVE                &kp MINUS                &kp SQT                                           &trans                   &trans                   &trans                   &trans                   &trans                   &trans                                            &kp LEFT                 &kp DOWN                 &kp UP                   &kp RIGHT                &trans
    // ╰────────────────────────┼────────────────────────┼────────────────────────┼────────────────────────┼────────────────────────┼────────────────────────┼────────────────────────┼────────────────────────┼────────────────────────┼────────────────────────┼────────────────────────┼────────────────────────┼────────────────────────┼────────────────────────┼────────────────────────┼────────────────────────┼────────────────────────┼────────────────────────╯
    >;
};
