L05_EMPTY {
  bindings = <
    // ╭────────────────────────┬────────────────────────┬────────────────────────┬────────────────────────┬────────────────────────┬────────────────────────┬────────────────────────┬────────────────────────┬────────────────────────┬────────────────────────┬────────────────────────┬────────────────────────┬────────────────────────┬────────────────────────┬────────────────────────┬────────────────────────┬────────────────────────┬────────────────────────╮
         &trans                   &kp N1                   &kp N2                   &kp N3                   &kp N4                   &kp N5                   &B_HT_MO_L L08 C_VOL_DN                                                                                                      &B_HT_MO_L L08 C_VOL_UP  &kp N6                   &kp N7                   &kp N8                   &kp N9                   &kp N0                   &trans
    // ├────────────────────────┼────────────────────────┼────────────────────────┼────────────────────────┼────────────────────────┼────────────────────────┼────────────────────────┼────────────────────────┼────────────────────────┼────────────────────────┼────────────────────────┼────────────────────────┼────────────────────────┼────────────────────────┼────────────────────────┼────────────────────────┼────────────────────────┼────────────────────────┤
         &trans                   &none                    &none                    &none                    &none                    &none                    &B_HT_MO_L L07 LC(X)                                                                                                         &B_HT_MO_L L07 RC(V)     &none                    &none                    &none                    &none                    &none                    &trans
    // ├────────────────────────┼────────────────────────┼────────────────────────┼────────────────────────┼────────────────────────┼────────────────────────┼────────────────────────┼────────────────────────┼────────────────────────┼────────────────────────┼────────────────────────┼────────────────────────┼────────────────────────┼────────────────────────┼────────────────────────┼────────────────────────┼────────────────────────┼────────────────────────┤
         &trans                   &none                    &none                    &none                    &none                    &none                    &B_HT_MO_L L06 LC(C)     &trans                   &trans                   &trans                   &trans                   &B_HT_MO_L L06 RS(RC(V)) &none                    &none                    &none                    &none                    &none                    &none
    // ├────────────────────────┼────────────────────────┼────────────────────────┼────────────────────────┼────────────────────────┼────────────────────────┼────────────────────────┼────────────────────────┼────────────────────────┼────────────────────────┼────────────────────────┼────────────────────────┼────────────────────────┼────────────────────────┼────────────────────────┼────────────────────────┼────────────────────────┼────────────────────────┤
         &trans                   &none                    &none                    &none                    &none                    &none                                                                      &trans                   &trans                                                                     &none                    &none                    &none                    &none                    &none                    &trans
    // ├────────────────────────┼────────────────────────┼────────────────────────┼────────────────────────┼────────────────────────┼────────────────────────┼────────────────────────┼────────────────────────┼────────────────────────┼────────────────────────┼────────────────────────┼────────────────────────┼────────────────────────┼────────────────────────┼────────────────────────┼────────────────────────┼────────────────────────┼────────────────────────┤
         &mo L00                  &none                    &none                    &kp LC(Z)                &kp LC(LEFT)                                      &trans                   &trans                   &trans                   &trans                   &trans                   &trans                                            &kp RC(RIGHT)            &kp RC(Y)                &none                    &none                    &mo L00
    // ╰────────────────────────┼────────────────────────┼────────────────────────┼────────────────────────┼────────────────────────┼────────────────────────┼────────────────────────┼────────────────────────┼────────────────────────┼────────────────────────┼────────────────────────┼────────────────────────┼────────────────────────┼────────────────────────┼────────────────────────┼────────────────────────┼────────────────────────┼────────────────────────╯
    >;
};
