L02_COLEMAK {
  bindings = <
    // ╭────────────────────────┬────────────────────────┬────────────────────────┬────────────────────────┬────────────────────────┬────────────────────────┬────────────────────────┬────────────────────────┬────────────────────────┬────────────────────────┬────────────────────────┬────────────────────────┬────────────────────────┬────────────────────────┬────────────────────────┬────────────────────────┬────────────────────────┬────────────────────────╮
         &trans                   &kp N1                   &kp N2                   &kp N3                   &kp N4                   &kp N5                   &B_HT_MO_L L08 C_VOL_DN                                                                                                      &B_HT_MO_L L08 C_VOL_UP  &kp N6                   &kp N7                   &kp N8                   &kp N9                   &kp N0                   &trans
    // ├────────────────────────┼────────────────────────┼────────────────────────┼────────────────────────┼────────────────────────┼────────────────────────┼────────────────────────┼────────────────────────┼────────────────────────┼────────────────────────┼────────────────────────┼────────────────────────┼────────────────────────┼────────────────────────┼────────────────────────┼────────────────────────┼────────────────────────┼────────────────────────┤
         &trans                   &kp Q                    &kp W                    &kp F                    &kp P                    &kp B                    &B_HT_MO_L L07 LC(X)                                                                                                         &B_HT_MO_L L07 RC(V)     &kp J                    &kp L                    &kp U                    &kp Y                    &kp SEMI                 &trans
    // ├────────────────────────┼────────────────────────┼────────────────────────┼────────────────────────┼────────────────────────┼────────────────────────┼────────────────────────┼────────────────────────┼────────────────────────┼────────────────────────┼────────────────────────┼────────────────────────┼────────────────────────┼────────────────────────┼────────────────────────┼────────────────────────┼────────────────────────┼────────────────────────┤
         &trans                   &kp A                    &kp R                    &kp S                    &kp T                    &kp G                    &B_HT_MO_L L06 LC(C)     &trans                   &trans                   &trans                   &trans                   &B_HT_MO_L L06 RS(RC(V)) &kp M                    &kp N                    &kp E                    &kp I                    &kp O                    &kp EQUAL
    // ├────────────────────────┼────────────────────────┼────────────────────────┼────────────────────────┼────────────────────────┼────────────────────────┼────────────────────────┼────────────────────────┼────────────────────────┼────────────────────────┼────────────────────────┼────────────────────────┼────────────────────────┼────────────────────────┼────────────────────────┼────────────────────────┼────────────────────────┼────────────────────────┤
         &trans                   &kp Z                    &kp X                    &kp C                    &kp D                    &kp V                                                                      &trans                   &trans                                                                     &kp K                    &kp H                    &kp COMMA                &kp DOT                  &kp FSLH                 &trans
    // ├────────────────────────┼────────────────────────┼────────────────────────┼────────────────────────┼────────────────────────┼────────────────────────┼────────────────────────┼────────────────────────┼────────────────────────┼────────────────────────┼────────────────────────┼────────────────────────┼────────────────────────┼────────────────────────┼────────────────────────┼────────────────────────┼────────────────────────┼────────────────────────┤
         &mo L00                  &kp GRAVE                &kp MINUS                &kp LC(Z)                &kp LC(LEFT)                                      &trans                   &trans                   &trans                   &trans                   &trans                   &trans                                            &kp RC(RIGHT)            &kp RC(Y)                &kp SQT                  &kp BSLH                 &mo L00
    // ╰────────────────────────┼────────────────────────┼────────────────────────┼────────────────────────┼────────────────────────┼────────────────────────┼────────────────────────┼────────────────────────┼────────────────────────┼────────────────────────┼────────────────────────┼────────────────────────┼────────────────────────┼────────────────────────┼────────────────────────┼────────────────────────┼────────────────────────┼────────────────────────╯
    >;
};
