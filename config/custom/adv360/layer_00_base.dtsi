L00_BASE {
    bindings = <
    // ╭────────────────────────┬────────────────────────┬────────────────────────┬────────────────────────┬────────────────────────┬────────────────────────┬────────────────────────┬────────────────────────┬────────────────────────┬────────────────────────┬────────────────────────┬────────────────────────┬────────────────────────┬────────────────────────┬────────────────────────┬────────────────────────┬────────────────────────┬────────────────────────╮
         &kp CLCK                 &kp F1                   &kp F2                   &kp F3                   &kp F4                   &kp F5                   &kp F11                                                                                                                      &kp F12                  &kp F6                   &kp F7                   &kp F8                   &kp F9                   &kp F10                  &kp RG(L)
    // ├────────────────────────┼────────────────────────┼────────────────────────┼────────────────────────┼────────────────────────┼────────────────────────┼────────────────────────┼────────────────────────┼────────────────────────┼────────────────────────┼────────────────────────┼────────────────────────┼────────────────────────┼────────────────────────┼────────────────────────┼────────────────────────┼────────────────────────┼────────────────────────┤
         &kp TAB                  &kp C_BRI_DN             &kp C_BRI_UP             &kp C_MUTE               &kp C_VOL_DN             &kp C_VOL_UP             &rgb_ug RGB_MEFS_CMD 5                                                                                                       &rgb_ug RGB_MEFS_CMD 5   &none                    &none                    &none                    &none                    &none                    &kp PSCRN
    // ├────────────────────────┼────────────────────────┼────────────────────────┼────────────────────────┼────────────────────────┼────────────────────────┼────────────────────────┼────────────────────────┼────────────────────────┼────────────────────────┼────────────────────────┼────────────────────────┼────────────────────────┼────────────────────────┼────────────────────────┼────────────────────────┼────────────────────────┼────────────────────────┤
         &kp ESC                  &none                    &none                    &kp C_PP                 &kp C_PREV               &kp C_NEXT               &bootloader              &kp LCTRL                &kp LALT                 &kp RALT                 &kp RCTRL                &bootloader              &none                    &none                    &none                    &none                    &none                    &kp RG(PAUSE_BREAK)
    // ├────────────────────────┼────────────────────────┼────────────────────────┼────────────────────────┼────────────────────────┼────────────────────────┼────────────────────────┼────────────────────────┼────────────────────────┼────────────────────────┼────────────────────────┼────────────────────────┼────────────────────────┼────────────────────────┼────────────────────────┼────────────────────────┼────────────────────────┼────────────────────────┤
         &kp LSHIFT               &none                    &none                    &none                    &kp C_RW                 &kp C_FF                                                                   &kp HOME                 &kp PG_UP                                                                  &none                    &none                    &none                    &none                    &none                    &kp RSHIFT
    // ├────────────────────────┼────────────────────────┼────────────────────────┼────────────────────────┼────────────────────────┼────────────────────────┼────────────────────────┼────────────────────────┼────────────────────────┼────────────────────────┼────────────────────────┼────────────────────────┼────────────────────────┼────────────────────────┼────────────────────────┼────────────────────────┼────────────────────────┼────────────────────────┤
         &mo L00                  &none                    &none                    &none                    &none                                             &kp BSPC                 &kp DEL                  &kp END                  &kp PG_DN                &kp RET                  &kp SPACE                                         &none                    &none                    &none                    &none                    &mo L00
    // ╰────────────────────────┼────────────────────────┼────────────────────────┼────────────────────────┼────────────────────────┼────────────────────────┼────────────────────────┼────────────────────────┼────────────────────────┼────────────────────────┼────────────────────────┼────────────────────────┼────────────────────────┼────────────────────────┼────────────────────────┼────────────────────────┼────────────────────────┼────────────────────────╯
    >;
};
