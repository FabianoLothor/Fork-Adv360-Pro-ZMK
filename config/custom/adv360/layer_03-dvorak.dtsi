L03_DVORAK {
  bindings = <
    // ╭────────────────────────┬────────────────────────┬────────────────────────┬────────────────────────┬────────────────────────┬────────────────────────┬────────────────────────┬────────────────────────┬────────────────────────┬────────────────────────┬────────────────────────┬────────────────────────┬────────────────────────┬────────────────────────┬────────────────────────┬────────────────────────┬────────────────────────┬────────────────────────╮
         &trans                   &kp N1                   &kp N2                   &kp N3                   &kp N4                   &kp N5                   &B_HT_MO_L L08 C_VOL_DN                                                                                                      &B_HT_MO_L L08 C_VOL_UP  &kp N6                   &kp N7                   &kp N8                   &kp N9                   &kp N0                   &trans
    // ├────────────────────────┼────────────────────────┼────────────────────────┼────────────────────────┼────────────────────────┼────────────────────────┼────────────────────────┼────────────────────────┼────────────────────────┼────────────────────────┼────────────────────────┼────────────────────────┼────────────────────────┼────────────────────────┼────────────────────────┼────────────────────────┼────────────────────────┼────────────────────────┤
         &trans                   &kp SQT                  &kp COMMA                &kp DOT                  &kp P                    &kp Y                    &B_HT_MO_L L07 LC(X)                                                                                                         &B_HT_MO_L L07 RC(V)     &kp F                    &kp G                    &kp C                    &kp R                    &kp L                    &trans
    // ├────────────────────────┼────────────────────────┼────────────────────────┼────────────────────────┼────────────────────────┼────────────────────────┼────────────────────────┼────────────────────────┼────────────────────────┼────────────────────────┼────────────────────────┼────────────────────────┼────────────────────────┼────────────────────────┼────────────────────────┼────────────────────────┼────────────────────────┼────────────────────────┤
         &trans                   &kp A                    &kp O                    &kp E                    &kp U                    &kp I                    &B_HT_MO_L L06 LC(C)     &trans                   &trans                   &trans                   &trans                   &B_HT_MO_L L06 RS(RC(V)) &kp D                    &kp H                    &kp T                    &kp N                    &kp S                    &kp EQUAL
    // ├────────────────────────┼────────────────────────┼────────────────────────┼────────────────────────┼────────────────────────┼────────────────────────┼────────────────────────┼────────────────────────┼────────────────────────┼────────────────────────┼────────────────────────┼────────────────────────┼────────────────────────┼────────────────────────┼────────────────────────┼────────────────────────┼────────────────────────┼────────────────────────┤
         &trans                   &kp SEMI                 &kp Q                    &kp J                    &kp K                    &kp X                                                                      &trans                   &trans                                                                     &kp B                    &kp M                    &kp W                    &kp V                    &kp Z                    &trans
    // ├────────────────────────┼────────────────────────┼────────────────────────┼────────────────────────┼────────────────────────┼────────────────────────┼────────────────────────┼────────────────────────┼────────────────────────┼────────────────────────┼────────────────────────┼────────────────────────┼────────────────────────┼────────────────────────┼────────────────────────┼────────────────────────┼────────────────────────┼────────────────────────┤
         &mo L00                  &kp GRAVE                &kp MINUS                &kp LC(Z)                &kp LC(LEFT)                                      &trans                   &trans                   &trans                   &trans                   &trans                   &trans                                            &kp RC(RIGHT)            &kp RC(Y)                &kp BSLH                 &kp FSLH                 &mo L00
    // ╰────────────────────────┼────────────────────────┼────────────────────────┼────────────────────────┼────────────────────────┼────────────────────────┼────────────────────────┼────────────────────────┼────────────────────────┼────────────────────────┼────────────────────────┼────────────────────────┼────────────────────────┼────────────────────────┼────────────────────────┼────────────────────────┼────────────────────────┼────────────────────────╯
    >;
};
