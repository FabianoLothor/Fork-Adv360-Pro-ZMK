L00_BASE {
    bindings = <
         &none                    &kp F1                   &kp F2                   &kp F3                   &kp F4                   &kp F5                   &kp F11                                                                                                                      &kp F12                  &kp F6                   &kp F7                   &kp F8                   &kp F9                   &kp F10                  &none
         &none                    &none                    &none                    &none                    &none                    &none                    &rgb_ug RGB_MEFS_CMD 5                                                                                                       &rgb_ug RGB_MEFS_CMD 5   &none                    &none                    &none                    &none                    &none                    &none
         &none                    &none                    &none                    &none                    &none                    &none                    &bootloader              &none                    &none                    &none                    &none                    &bootloader              &none                    &none                    &none                    &none                    &none                    &none
         &none                    &none                    &none                    &none                    &none                    &none                                                                      &none                    &none                                                                      &none                    &none                    &none                    &none                    &none                    &none
         &none                    &none                    &none                    &none                    &none                                             &none                    &none                    &none                    &none                    &none                    &none                                             &none                    &none                    &none                    &none                    &none
    >;
};
