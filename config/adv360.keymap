#include <behaviors.dtsi>
#include <dt-bindings/zmk/backlight.h>
#include <dt-bindings/zmk/bt.h>
#include <dt-bindings/zmk/keys.h>
#include <dt-bindings/zmk/rgb.h>

#include "custom/adv360/vars.h"

#include "custom/adv360/key_positions-base.h"
#include "custom/adv360/key_positions-colemak.h"
#include "custom/adv360/key_positions-dvorak.h"
#include "custom/adv360/key_positions-qwerty.h"

/ {
    behaviors {
                                behavior-hold_tap-kp-left
        #include "custom/adv360/behavior-hold_tap-kp-left.dtsi"
        #include "custom/adv360/behavior-hold_tap-kp-right.dtsi"
        #include "custom/adv360/behavior-hold_tap-mo-left.dtsi"
        #include "custom/adv360/behavior-hold_tap-mo-right.dtsi"
    };

    combos {
        compatible = "zmk,combos";

        C_L00_TO_L05 {
            bindings = <&to 5>;
            key-positions = <68 67>;
            layers = <0>;
            require-prior-idle-ms = <100>;
        };

        C_L00_TO_L01 {
            bindings = <&to 1>;
            key-positions = <52 53>;
            layers = <0>;
            require-prior-idle-ms = <100>;
        };

        C_L01_TO_L00 {
            bindings = <&to 0>;
            key-positions = <67 68>;
            layers = <1>;
            require-prior-idle-ms = <100>;
        };

        C_L01_TO_L02 {
            bindings = <&to 2>;
            key-positions = <52 53>;
            layers = <1>;
            require-prior-idle-ms = <100>;
        };

        C_L02_TO_L01 {
            bindings = <&to 1>;
            key-positions = <67 68>;
            layers = <2>;
            require-prior-idle-ms = <100>;
        };

        C_L02_TO_L03 {
            bindings = <&to 3>;
            key-positions = <53 52>;
            layers = <2>;
            require-prior-idle-ms = <100>;
        };

        C_L03_TO_L02 {
            bindings = <&to 2>;
            key-positions = <67 68>;
            layers = <3>;
            require-prior-idle-ms = <100>;
        };

        C_L03_TO_L04 {
            bindings = <&to 4>;
            key-positions = <52 53>;
            layers = <3>;
            require-prior-idle-ms = <100>;
        };

        C_L04_TO_L03 {
            bindings = <&to 3>;
            key-positions = <67 68>;
            layers = <4>;
            require-prior-idle-ms = <100>;
        };

        C_L04_TO_L05 {
            bindings = <&to 5>;
            key-positions = <53 52>;
            layers = <4>;
            require-prior-idle-ms = <100>;
        };

        C_L05_TO_L00 {
            bindings = <&to 0>;
            key-positions = <52 53>;
            layers = <5>;
            require-prior-idle-ms = <100>;
        };

        C_L05_TO_L04 {
            bindings = <&to 4>;
            key-positions = <68 67>;
            layers = <5>;
            require-prior-idle-ms = <100>;
        };

        C_BT_NEXT {
            bindings = <&bt BT_NXT>;
            key-positions = <35 38>;
            require-prior-idle-ms = <100>;
        };

        C_BT_PREV {
            bindings = <&bt BT_PRV>;
            key-positions = <36 37>;
            require-prior-idle-ms = <100>;
        };

        C_BT_CLEAR {
            bindings = <&bt BT_CLR>;
            key-positions = <35 36 37 38>;
            layers = <0>;
            require-prior-idle-ms = <100>;
        };

        C_TOGGLE_LEDS {
            bindings = <&bl BL_TOG>;
            key-positions = <65 66 70 69>;
            require-prior-idle-ms = <100>;
        };
    };

    macros {
        #include "version.dtsi"
        #ifndef VERSION_MACRO

        macro_ver: macro_ver {
            compatible = "zmk,behavior-macro";
            label = "macro_version";
            #binding-cells = <0>;
            bindings = <&kp RET>;
        };

        #endif

        BM_SQ: BM_SQ {
            compatible = "zmk,behavior-macro";
            label = "BM_SQ";
            #binding-cells = <0>;
            bindings = <&kp SQT &kp SQT &kp LEFT>;
        };

        BM_DQ: BM_DQ {
            compatible = "zmk,behavior-macro";
            label = "BM_DQ";
            #binding-cells = <0>;
            bindings = <&kp DQT &kp DQT &kp LEFT>;
        };

        BM_AB: BM_AB {
            compatible = "zmk,behavior-macro";
            label = "BM_AB";
            #binding-cells = <0>;
            bindings = <&kp LT &kp GT &kp LEFT>;
        };

        BM_CB: BM_CB {
            compatible = "zmk,behavior-macro";
            label = "BM_CB";
            #binding-cells = <0>;
            bindings = <&kp LBRC &kp RBRC &kp LEFT>;
        };

        BM_RB: BM_RB {
            compatible = "zmk,behavior-macro";
            label = "BM_RB";
            #binding-cells = <0>;
            bindings = <&kp LPAR &kp RPAR &kp LEFT>;
        };

        BM_SB: BM_SB {
            compatible = "zmk,behavior-macro";
            label = "BM_SB";
            #binding-cells = <0>;
            bindings = <&kp LBKT &kp RBKT &kp LEFT>;
        };
    };

    keymap {
        compatible = "zmk,keymap";

        #include "custom/adv360/layer_00-base.dtsi"
        #include "custom/adv360/layer_01-qwerty.dtsi"
        #include "custom/adv360/layer_02-colemak.dtsi"
        #include "custom/adv360/layer_03-dvorak.dtsi"
        #include "custom/adv360/layer_04-empty.dtsi"
        #include "custom/adv360/layer_05-empty.dtsi"
        #include "custom/adv360/layer_06-symbols.dtsi"
        #include "custom/adv360/layer_07-navigation.dtsi"
        #include "custom/adv360/layer_08-keypad.dtsi"
    };
};
